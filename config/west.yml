## config/west.yml
```yaml
manifest:
  remotes:
    - name: zmkfirmware
      url-base: https://github.com/zmkfirmware
    - name: petejohanson
      url-base: https://github.com/petejohanson
  projects:
    - name: zmk
      remote: petejohanson
      revision: ble/sc-passkey-entry
      import: app/west.yml
  self:
    path: config
```

## native_posix_config/boards/shields/zmk_linux/Kconfig.defconfig
```kconfig
# Copyright (c) 2020 The ZMK Contributors
# SPDX-License-Identifier: MIT

if SHIELD_RPI

config ZMK_KEYBOARD_NAME
    default "rpi-wow"

endif
```

## native_posix_config/boards/shields/zmk_linux/Kconfig.shield
```kconfig
# Copyright (c) 2020 The ZMK Contributors
# SPDX-License-Identifier: MIT

config SHIELD_RPI
    def_bool $(shields_list_contains,rpi)
```
